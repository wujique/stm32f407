/**
 * @file            dev_dacsound.c
 * @brief           使用DAC输出8K语音
 * @author          wujique
 * @date            2018年1月24日 星期三
 * @version         初稿
 * @par             版权所有 (C), 2013-2023
 * @par History:
 * 1.日    期:        2018年1月24日 星期三
 *   作    者:         屋脊雀工作室
 *   修改内容:   创建文件
      	1 源码归屋脊雀工作室所有。
		2 可以用于的其他商业用途（配套开发板销售除外），不须授权。
		3 屋脊雀工作室不对代码功能做任何保证，请使用者自行测试，后果自负。
		4 可随意修改源码并分发，但不可直接销售本代码获利，并且请保留WUJIQUE版权说明。
		5 如发现BUG或有优化，欢迎发布更新。请联系：code@wujique.com
		6 使用本源码则相当于认同本版权说明。
		7 如侵犯你的权利，请联系：code@wujique.com
		8 一切解释权归屋脊雀工作室所有。
*/
#include "stm32f4xx.h"
#include "wujique_log.h"
#include "mcu_dac.h"
#include "mcu_timer.h"

//#define DEV_DACSOUND_DEBUG

#ifdef DEV_DACSOUND_DEBUG
#define DACSOUND_DEBUG	wjq_log 
#else
#define DACSOUND_DEBUG(a, ...)
#endif

/*
测试硬件的时候使用
*/
#if 0


#define BEEP_DATA_LEN   ((561-21)*16)

const u8 BeepData[BEEP_DATA_LEN]=
{
	0x00 ,0x00 ,0x6D ,0x00 ,0x2C ,0x01 ,0x3B ,0x01 ,0x43 ,0x00 ,0x08 ,0xFF ,0xAA ,0xFE ,0x5F ,0xFF,
	0x0E ,0x00 ,0x68 ,0xFF ,0x75 ,0xFD ,0x17 ,0xFC ,0x8C ,0xFD ,0x2A ,0x02 ,0x60 ,0x07 ,0x45 ,0x09,
	0xB0 ,0x05 ,0x5B ,0xFE ,0xF2 ,0xF7 ,0x91 ,0xF6 ,0x82 ,0xFA ,0x10 ,0x00 ,0xC3 ,0x02 ,0x4B ,0x01,
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	0x00 ,0x00 ,0x00 ,0x00 ,0x00 ,0x00 ,0x00 ,0x00 ,0x00 ,0x00 ,0x00 ,0x00 ,0x01 ,0x00 ,0x00 ,0x00,

};
/*

	DAC 播放声音，固定播放8K单声道16BIT的音源。

*/

u32 soundindex =0;

s32 dev_dacsound_init(void)
{
	return 0;
}

s32 dev_dacsound_open(void)
{
	mcu_dac_open();
	mcu_tim3_init();
	return 0;
}
/**
 *@brief:      dev_dacsound_play
 *@details:    启动DAC语音播放
 *@param[in]   void  
 *@param[out]  无
 *@retval:     
 */
s32 dev_dacsound_play(void)
{
	soundindex = 0;

	/*打开定时器，启动播放*/
	DACSOUND_DEBUG(LOG_DEBUG, "dac sound play\r\n");
	mcu_tim3_start();
	return 0;
}

/*
	
*/
/**
 *@brief:     dev_dacsound_timerinit
 *@details:   在定时器中断中调用，每125US输出一个DAC数据
 *@param[in]  void  
 *@param[out]  无
 *@retval:     
 */
s32 dev_dacsound_timerinit(void)
{
    u8 data1 = 0, data2 = 0;
    s16 data = 0;
    u16 tmp;

	data1 = BeepData[soundindex++];
	data2 = BeepData[soundindex++];
	/*要注意，读到的数据是S16，正负值*/
	data = (s16)((data2 << 8) | data1);
	tmp = (data+0X7FFF)>>4;//12位DAC
	DACSOUND_DEBUG(LOG_DEBUG, "%04x ", tmp);
	mcu_dac_output(tmp);

	if(soundindex >= BEEP_DATA_LEN)
	{
		DACSOUND_DEBUG(LOG_DEBUG, "dac sound play finish!");
		/*停止定时器*/
		mcu_tim3_stop();
	}
	return 0;
}


s32 dev_dacsound_test(void)
{
	dev_dacsound_open();
	
	while(1)
	{
		Delay(2000);
		dev_dacsound_play();
	}

}
#else
/*

	DAC 播放声音，固定播放8K单声道16BIT的音源。

*/

u16 *DacSoundSampleP0;
u16 *DacSoundSampleP1;
u16 *DacSoundCrBufP;//当前使用的BUF

u32 DacSoundSampleBufSize;
u32 DacSoundSampleIndex;

s32 dev_dacsound_init(void)
{
	GPIO_InitTypeDef GPIO_InitStructure;
	
	GPIO_InitStructure.GPIO_Pin = GPIO_Pin_5;
    GPIO_InitStructure.GPIO_Mode = GPIO_Mode_OUT;//---模拟模式
    GPIO_InitStructure.GPIO_PuPd = GPIO_PuPd_UP;//---下拉
    GPIO_InitStructure.GPIO_Speed = GPIO_Speed_50MHz;
    GPIO_Init(GPIOA, &GPIO_InitStructure);//---初始化 GPIO

	GPIO_ResetBits(GPIOA, GPIO_Pin_5);
	
	return 0;
}

s32 dev_dacsound_open(void)
{
	mcu_dac_open();
	mcu_tim3_init();
	DacSoundSampleIndex = 0;
	DacSoundCrBufP = DacSoundSampleP0;
	
	return 0;
}
/**
 *@brief:      dev_dacsound_dataformat
 *@details:       设置播放配置，DAC播放固定支持8K 16BIT 单声-
                  道
 *@param[in]   u32 Freq     
               u8 Standard  
               u8 Format    
 *@param[out]  无
 *@retval:     
 */
s32 dev_dacsound_dataformat(u32 Freq, u8 Standard, u8 Format)
{
	return 0;
}
/**
 *@brief:      dev_dacsound_setbuf
 *@details:    设置播放缓冲
 *@param[in]   u16 *buffer0  
               u16 *buffer1  
               u32 len       
 *@param[out]  无
 *@retval:     
 */
s32 dev_dacsound_setbuf(u16 *buffer0,u16 *buffer1,u32 len)
{
	DacSoundSampleP0 = buffer0;
	DacSoundSampleP1 = buffer1;
	DacSoundSampleBufSize = len;
	
	return 0;
}
/**
 *@brief:      dev_dacsound_transfer
 *@details:    启动或停止DAC播放
 *@param[in]   u8 sta  
 *@param[out]  无
 *@retval:     
 */
s32 dev_dacsound_transfer(u8 sta)
{
	if(sta == 1)
	{
		/*打开定时器，启动播放*/
		DACSOUND_DEBUG(LOG_DEBUG, "dac sound play\r\n");
		mcu_tim3_start();
	}
	else
	{
		/*停止定时器*/
		mcu_tim3_stop();
	}
	
	return 0;
}

s32 dev_dacsound_close(void)
{
	dev_dacsound_init();
	return 0;
}

/**
 *@brief:      dev_dacsound_timerinit
 *@details:    在定时器中断中调用，每125US输出一个DAC数据
 			   能不能改为DMA？
 *@param[in]   void  
 *@param[out]  无
 *@retval:     
 */
s32 dev_dacsound_timerinit(void)
{
    s16 data = 0;
    u16 tmp;

	if(DacSoundSampleIndex >= DacSoundSampleBufSize)
	{
		if(DacSoundCrBufP == DacSoundSampleP0)
		{
			DacSoundCrBufP = DacSoundSampleP1;
			fun_sound_set_free_buf(0);
		}
		else
		{
			DacSoundCrBufP = DacSoundSampleP0;
			fun_sound_set_free_buf(1);
		}
		DacSoundSampleIndex = 0;

	}

	/*要注意，读到的数据是S16，正负值*/
	data = *(DacSoundCrBufP + DacSoundSampleIndex);
	/*
		先压缩，也就是减少音量，在负数时候压缩（除）
		压缩方向时中位值，如果先将负数调整为正数（抬高直流电平），
		压缩方向就会变成音频的最低值，音效会失真。
	*/
	data = data/(16+30);//12位DAC，再加上音量设置，
	/*再调整中位值(直流电平)，因为音频数据有负数，DAC输出没有负数*/
	tmp = (data+0x800);
	mcu_dac_output(tmp);
	
	DacSoundSampleIndex++;
	return 0;
}

#endif

